## main/Kconfig.projbuild
```kconfig
menu "Xiaozhi WiFi STA Configuration"

    config ESP_WIFI_SSID
        string "WiFi STA SSID"
        default ""
        help
            SSID for the device to connect to in WiFi station mode.

    config ESP_WIFI_PASSWORD
        string "WiFi STA Password"
        default ""
        help
            WiFi password for station mode. Leave empty when connecting to an open AP.

    choice ESP_WIFI_SAE_MODE
        prompt "WPA3 SAE mode selection"
        default ESP_WPA3_SAE_PWE_BOTH
        help
            Select mode for SAE as Hunt and Peck, H2E or both.
        config ESP_WPA3_SAE_PWE_HUNT_AND_PECK
            bool "HUNT AND PECK"
        config ESP_WPA3_SAE_PWE_HASH_TO_ELEMENT
            bool "H2E"
        config ESP_WPA3_SAE_PWE_BOTH
            bool "BOTH"
    endchoice

    config ESP_WIFI_PW_ID
        string "PASSWORD IDENTIFIER"
        depends on  ESP_WPA3_SAE_PWE_HASH_TO_ELEMENT|| ESP_WPA3_SAE_PWE_BOTH
        default ""
        help
            password identifier for SAE H2E

    config ESP_MAXIMUM_RETRY
        int "Maximum retry"
        default 5
        range 1 20
        help
            Maximum station reconnect attempts before reporting connection failure.

    choice ESP_WIFI_SCAN_AUTH_MODE_THRESHOLD
        prompt "WiFi Scan auth mode threshold"
        default ESP_WIFI_AUTH_WPA2_PSK
        help
            The weakest authmode to accept in the scan mode.
            This value defaults to ESP_WIFI_AUTH_WPA2_PSK incase password is present and ESP_WIFI_AUTH_OPEN is used.
            Please select ESP_WIFI_AUTH_WEP/ESP_WIFI_AUTH_WPA_PSK incase AP is operating in WEP/WPA mode.

        config ESP_WIFI_AUTH_OPEN
            bool "OPEN"
        config ESP_WIFI_AUTH_WEP
            bool "WEP"
        config ESP_WIFI_AUTH_WPA_PSK
            bool "WPA PSK"
        config ESP_WIFI_AUTH_WPA2_PSK
            bool "WPA2 PSK"
        config ESP_WIFI_AUTH_WPA_WPA2_PSK
            bool "WPA/WPA2 PSK"
        config ESP_WIFI_AUTH_WPA3_PSK
            bool "WPA3 PSK"
        config ESP_WIFI_AUTH_WPA2_WPA3_PSK
            bool "WPA2/WPA3 PSK"
        config ESP_WIFI_AUTH_WAPI_PSK
            bool "WAPI PSK"
    endchoice

endmenu

menu "Xiaozhi Agent Stage1 Configuration"

    config XIAOZHI_OTA_URL
        string "Xiaozhi OTA URL"
        default "https://api.tenclass.net/xiaozhi/ota/"
        help
            HTTPS endpoint used after WiFi provisioning to request websocket and activation information.

    config XIAOZHI_BOARD_NAME
        string "Xiaozhi board name"
        default "atguigu-ai-xiaozhi-doorbell"
        help
            Board name sent in OTA request body and User-Agent.

    config XIAOZHI_BOARD_TYPE
        string "Xiaozhi board type"
        default "esp32s3"
        help
            Board type sent in OTA request body and User-Agent.

    config XIAOZHI_HTTP_TIMEOUT_MS
        int "Xiaozhi HTTP timeout (ms)"
        default 10000
        range 1000 60000
        help
            Timeout for the stage1 OTA activation HTTP request.

    config XIAOZHI_OTA_NET_READY_TIMEOUT_MS
        int "Xiaozhi OTA network ready timeout (ms)"
        default 15000
        range 1000 60000
        help
            Maximum time to wait for a valid STA IPv4 address before the OTA
            activation HTTP request starts.

    config XIAOZHI_OTA_DNS_RETRY_COUNT
        int "Xiaozhi OTA DNS/connect retry count"
        default 3
        range 1 10
        help
            Number of retries for DNS resolution or HTTP connect failures
            before the stage1 OTA activation request gives up.

    config XIAOZHI_OTA_DNS_RETRY_DELAY_MS
        int "Xiaozhi OTA DNS/connect retry delay (ms)"
        default 1000
        range 100 10000
        help
            Delay between OTA DNS resolution or HTTP connect retries.

    config XIAOZHI_STAGE1_AUTO_SR_ENABLE
        bool "Start WakeNet/VAD SR automatic dialogue"
        default y
        help
            Start WakeNet/VAD SR for the P3 automatic dialogue path. WakeNet
            owns the 16 kHz microphone path, VAD starts the Opus uplink from
            processed SR PCM, and downlink playback explicitly pauses SR before
            taking codec ownership.

    config XIAOZHI_STAGE1_WAKE_ONLY_SR_ENABLE
        bool "Start WakeNet-only SR after WebSocket READY"
        default n
        help
            Start WakeNet-only SR after the Xiaozhi WebSocket handshake
            reaches READY. This keeps VAD and PCM uplink detached so the
            wake path can be validated without entering automatic dialogue.

    config XIAOZHI_AUDIO_DIAG_ENABLE
        bool "Build audio diagnostics helpers"
        default n
        help
            Build board-level audio diagnostics helpers. This does not run
            tone playback or local loopback automatically; callers must invoke
            the diagnostic functions explicitly.

    config XIAOZHI_AUDIO_MIC_GAIN_DB
        int "ES8311 microphone input gain (dB)"
        default 30
        range 0 42
        help
            Analog microphone gain applied through esp_codec_dev_set_in_gain()
            after opening the ES8311 codec. Increase if direct capture PCM RMS
            is too low; reduce if clip_samples increases or peaks saturate.

    config XIAOZHI_AUDIO_DIAG_TONE_MS
        int "Audio diagnostics 1 kHz tone duration (ms)"
        depends on XIAOZHI_AUDIO_DIAG_ENABLE
        default 500
        range 20 10000
        help
            Duration used by audio_diag_play_1khz_tone().

    config XIAOZHI_AUDIO_DIAG_MIC_RMS_DURATION_MS
        int "Audio diagnostics mic RMS total duration (ms)"
        depends on XIAOZHI_AUDIO_DIAG_ENABLE
        default 5000
        range 100 60000
        help
            Total capture duration used by audio_diag_print_mic_rms().

    config XIAOZHI_AUDIO_DIAG_MIC_RMS_WINDOW_MS
        int "Audio diagnostics mic RMS log window (ms)"
        depends on XIAOZHI_AUDIO_DIAG_ENABLE
        default 500
        range 20 10000
        help
            Log window used by audio_diag_print_mic_rms().

    config XIAOZHI_AUDIO_DIAG_LOOPBACK_MS
        int "Audio diagnostics local loopback duration (ms)"
        depends on XIAOZHI_AUDIO_DIAG_ENABLE
        default 5000
        range 20 60000
        help
            Duration used by audio_diag_loopback(). Keep short to reduce
            feedback/howling risk during bench tests.

    config XIAOZHI_AUDIO_DIAG_LOOPBACK_GAIN
        int "Audio diagnostics local loopback digital gain"
        depends on XIAOZHI_AUDIO_DIAG_ENABLE
        default 1
        range 1 16
        help
            Integer digital gain applied only inside audio_diag_loopback().
            Increase this when raw microphone PCM is too quiet to hear.

    config XIAOZHI_AUDIO_DIAG_LOOPBACK_LOG_MS
        int "Audio diagnostics local loopback log window (ms)"
        depends on XIAOZHI_AUDIO_DIAG_ENABLE
        default 500
        range 20 10000
        help
            Log interval for loopback min/max/RMS diagnostics.

    config XIAOZHI_AUDIO_DIAG_VOLUME
        int "Audio diagnostics output volume"
        depends on XIAOZHI_AUDIO_DIAG_ENABLE
        default 40
        range 0 100
        help
            Output volume set before diagnostic playback.

    config XIAOZHI_AUDIO_DIAG_TONE_AMPLITUDE
        int "Audio diagnostics 1 kHz tone amplitude"
        depends on XIAOZHI_AUDIO_DIAG_ENABLE
        default 12000
        range 1000 30000
        help
            16-bit PCM amplitude used for the 1 kHz test tone.

    config XIAOZHI_AUDIO_OPUS_DIAG_ENABLE
        bool "Build local Opus encode/decode diagnostics"
        default n
        select AUDIO_ENCODER_OPUS_SUPPORT
        select AUDIO_DECODER_OPUS_SUPPORT
        help
            Build local PCM -> Opus -> PCM diagnostics. This does not connect
            to WebSocket or the Xiaozhi backend and does not run automatically.

    config XIAOZHI_AUDIO_OPUS_STREAM_ENABLE
        bool "Build Xiaozhi WebSocket Opus audio stream"
        default y
        select AUDIO_ENCODER_OPUS_SUPPORT
        select AUDIO_DECODER_OPUS_SUPPORT
        help
            Enable the production Xiaozhi voice path: SR PCM to Opus uplink and
            WebSocket Opus downlink to speaker playback.

    choice XIAOZHI_AUDIO_OPUS_DIAG_FRAME_DURATION
        prompt "Opus diagnostics frame duration"
        depends on XIAOZHI_AUDIO_OPUS_DIAG_ENABLE
        default XIAOZHI_AUDIO_OPUS_DIAG_FRAME_DURATION_60_MS
        help
            Use 60 ms for the target 1920-byte PCM loopback test. Use 20 ms
            only as an A/B probe if the vendor Opus encoder crashes before
            producing the first frame.

        config XIAOZHI_AUDIO_OPUS_DIAG_FRAME_DURATION_20_MS
            bool "20 ms (640-byte PCM probe)"

        config XIAOZHI_AUDIO_OPUS_DIAG_FRAME_DURATION_60_MS
            bool "60 ms (1920-byte PCM target)"
    endchoice

    config XIAOZHI_AUDIO_OPUS_DIAG_FRAME_DURATION_MS
        int
        depends on XIAOZHI_AUDIO_OPUS_DIAG_ENABLE
        default 20 if XIAOZHI_AUDIO_OPUS_DIAG_FRAME_DURATION_20_MS
        default 60 if XIAOZHI_AUDIO_OPUS_DIAG_FRAME_DURATION_60_MS

    config XIAOZHI_AUDIO_OPUS_DIAG_TONE_LOOPBACK_MS
        int "Opus diagnostics 1 kHz loopback duration (ms)"
        depends on XIAOZHI_AUDIO_OPUS_DIAG_ENABLE
        default 5000
        range 60 60000
        help
            Duration used by audio_opus_diag_play_1khz_loopback().

    config XIAOZHI_AUDIO_OPUS_DIAG_MIC_LOOPBACK_MS
        int "Opus diagnostics mic loopback duration (ms)"
        depends on XIAOZHI_AUDIO_OPUS_DIAG_ENABLE
        default 10000
        range 60 300000
        help
            Duration used by audio_opus_diag_mic_loopback().

    config XIAOZHI_AUDIO_OPUS_DIAG_MIC_INPUT_BYTES
        int "Opus diagnostics mic input chunk bytes"
        depends on XIAOZHI_AUDIO_OPUS_DIAG_ENABLE
        default 1024
        range 320 1920
        help
            PCM chunk size read from the mic before buffering into 60 ms Opus
            frames. Use 1024 to match the observed SR fetch output size.

    config XIAOZHI_AUDIO_OPUS_DIAG_LOG_WINDOW_MS
        int "Opus diagnostics log window (ms)"
        depends on XIAOZHI_AUDIO_OPUS_DIAG_ENABLE
        default 500
        range 60 10000
        help
            Log interval for Opus loopback frame statistics.

    config XIAOZHI_AUDIO_OPUS_DIAG_VOLUME
        int "Opus diagnostics output volume"
        depends on XIAOZHI_AUDIO_OPUS_DIAG_ENABLE
        default 65
        range 0 100
        help
            Output volume set before Opus diagnostic playback.

    config XIAOZHI_AUDIO_OPUS_DIAG_TONE_AMPLITUDE
        int "Opus diagnostics 1 kHz tone amplitude"
        depends on XIAOZHI_AUDIO_OPUS_DIAG_ENABLE
        default 10000
        range 1000 30000
        help
            16-bit PCM amplitude used for the Opus 1 kHz test tone.

    config XIAOZHI_AUDIO_OPUS_DIAG_BITRATE
        int "Opus diagnostics bitrate"
        depends on XIAOZHI_AUDIO_OPUS_DIAG_ENABLE
        default 90000
        range 20000 256000
        help
            Constant Opus bitrate in bits per second.

    config XIAOZHI_AUDIO_OPUS_DIAG_COMPLEXITY
        int "Opus diagnostics encoder complexity"
        depends on XIAOZHI_AUDIO_OPUS_DIAG_ENABLE
        default 0
        range 0 10
        help
            Opus encoder complexity. Keep low during board bring-up to reduce
            CPU load.

    config XIAOZHI_AUDIO_OPUS_DIAG_SOURCE_TASK_STACK_SIZE
        int "Opus diagnostics source task stack size"
        depends on XIAOZHI_AUDIO_OPUS_DIAG_ENABLE
        default 8192
        range 4096 32768

    config XIAOZHI_AUDIO_OPUS_DIAG_ENCODER_TASK_STACK_SIZE
        int "Opus diagnostics encoder task stack size"
        depends on XIAOZHI_AUDIO_OPUS_DIAG_ENABLE
        default 49152
        range 16384 65536

    config XIAOZHI_AUDIO_OPUS_DIAG_BRIDGE_TASK_STACK_SIZE
        int "Opus diagnostics bridge task stack size"
        depends on XIAOZHI_AUDIO_OPUS_DIAG_ENABLE
        default 4096
        range 3072 16384

    config XIAOZHI_AUDIO_OPUS_DIAG_DECODER_TASK_STACK_SIZE
        int "Opus diagnostics decoder task stack size"
        depends on XIAOZHI_AUDIO_OPUS_DIAG_ENABLE
        default 24576
        range 8192 32768

    config XIAOZHI_AUDIO_OPUS_DIAG_PCM_RING_BYTES
        int "Opus diagnostics PCM ringbuffer bytes"
        depends on XIAOZHI_AUDIO_OPUS_DIAG_ENABLE
        default 32768
        range 4096 131072

    config XIAOZHI_AUDIO_OPUS_DIAG_OPUS_RING_BYTES
        int "Opus diagnostics Opus ringbuffer bytes"
        depends on XIAOZHI_AUDIO_OPUS_DIAG_ENABLE
        default 32768
        range 8192 131072

endmenu

menu "Xiaozhi Provisioning Configuration"

    choice APP_PROV_TRANSPORT
        prompt "Provisioning transport"
        default APP_PROV_TRANSPORT_BLE
        help
            Select which provisioning strategy the factory creates at runtime.

        config APP_PROV_TRANSPORT_BLE
            bool "BLE provisioning"

        config APP_PROV_TRANSPORT_SOFTAP
            bool "SoftAP provisioning"
    endchoice

    config APP_PROV_SERVICE_NAME
        string "Provisioning service name"
        default "XIAOZHI_PROV"
        help
            BLE device name or SoftAP SSID advertised during provisioning.

    config APP_PROV_SERVICE_KEY
        string "SoftAP service key"
        default "xiaozhi123"
        help
            SoftAP password. Ignored by BLE provisioning.

    config APP_PROV_POP
        string "Proof of possession"
        default "abcd1234"
        help
            Proof of possession used by secure provisioning.

    config APP_PROV_STOP_DELAY_MS
        int "Provisioning stop delay (ms)"
        default 500
        range 0 60000
        help
            Fallback delay used by wifi_prov_mgr auto-stop handling. Xiaozhi
            business startup is gated by WiFi got IP and provisioning deinit,
            not by this delay.

endmenu
```

## sdkconfig.defaults
```kconfig
CONFIG_BT_ENABLED=y
CONFIG_BT_NIMBLE_ENABLED=y
# CONFIG_BT_BLUEDROID_ENABLED is not set
CONFIG_PARTITION_TABLE_CUSTOM=y
CONFIG_PARTITION_TABLE_CUSTOM_FILENAME="partitions.csv"
CONFIG_PARTITION_TABLE_FILENAME="partitions.csv"
CONFIG_APP_PROV_STOP_DELAY_MS=500
CONFIG_XIAOZHI_OTA_NET_READY_TIMEOUT_MS=15000
CONFIG_XIAOZHI_OTA_DNS_RETRY_COUNT=3
CONFIG_XIAOZHI_OTA_DNS_RETRY_DELAY_MS=1000
# CONFIG_XIAOZHI_STAGE1_AUTO_SR_ENABLE is not set
CONFIG_LV_USE_QRCODE=y
CONFIG_LV_FONT_MONTSERRAT_20=y
CONFIG_LV_FONT_DEFAULT_MONTSERRAT_14=y
CONFIG_SPIRAM=y
CONFIG_SPIRAM_MODE_QUAD=y
CONFIG_SPIRAM_SPEED_80M=y
CONFIG_SPIRAM_BOOT_INIT=y
# CONFIG_SPIRAM_USE_CAPS_ALLOC is not set
CONFIG_SPIRAM_USE_MALLOC=y
CONFIG_SPIRAM_MALLOC_ALWAYSINTERNAL=2048
CONFIG_SPIRAM_MALLOC_RESERVE_INTERNAL=65536
CONFIG_SPIRAM_ALLOW_STACK_EXTERNAL_MEMORY=y
CONFIG_MBEDTLS_EXTERNAL_MEM_ALLOC=y
# CONFIG_MBEDTLS_INTERNAL_MEM_ALLOC is not set
CONFIG_MBEDTLS_ASYMMETRIC_CONTENT_LEN=y
CONFIG_MBEDTLS_SSL_IN_CONTENT_LEN=8192
CONFIG_MBEDTLS_SSL_OUT_CONTENT_LEN=4096
CONFIG_WS_BUFFER_SIZE=1024
CONFIG_MODEL_IN_FLASH=y
# CONFIG_MODEL_IN_SDCARD is not set
CONFIG_SR_NSN_WEBRTC=y
# CONFIG_SR_VADN_WEBRTC is not set
CONFIG_SR_VADN_VADNET1_MEDIUM=y
# CONFIG_SR_WN_WN9_HIESP is not set
CONFIG_SR_WN_WN9_HIMIAOMIAO_TTS=y
CONFIG_AUDIO_ENCODER_OPUS_SUPPORT=y
CONFIG_AUDIO_DECODER_OPUS_SUPPORT=y
```
