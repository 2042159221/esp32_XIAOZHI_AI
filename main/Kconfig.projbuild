## test_apps/audio_board_test/main/Kconfig.projbuild
```kconfig
menu "Audio Board Test"

    config AUDIO_BOARD_TEST_RUN_I2C_SCAN
        bool "Run audio I2C scan"
        default y

    config AUDIO_BOARD_TEST_RUN_1KHZ_TONE
        bool "Play 1 kHz test tone"
        default n

    config AUDIO_BOARD_TEST_RUN_MIC_RMS
        bool "Print microphone min/max/RMS"
        default y

    config AUDIO_BOARD_TEST_RUN_LOCAL_LOOPBACK
        bool "Run local mic-to-speaker loopback"
        default y
        help
            Disabled by default to avoid acoustic feedback. Enable only during
            controlled bench testing.

    config AUDIO_BOARD_TEST_RUN_OPUS_1KHZ_LOOPBACK
        bool "Run local 1 kHz Opus encode/decode loopback"
        default n
        select AUDIO_ENCODER_OPUS_SUPPORT
        select AUDIO_DECODER_OPUS_SUPPORT
        help
            Generates 1 kHz PCM locally, encodes it to Opus, decodes it back
            to PCM, and plays it through the speaker.

    config AUDIO_BOARD_TEST_RUN_OPUS_MIC_LOOPBACK
        bool "Run local mic Opus encode/decode loopback"
        default n
        select AUDIO_ENCODER_OPUS_SUPPORT
        select AUDIO_DECODER_OPUS_SUPPORT
        help
            Reads local mic PCM, buffers chunks into 60 ms Opus frames, encodes
            and decodes locally, then plays the decoded PCM through speaker.

    config AUDIO_BOARD_TEST_RUN_WS_ECHO
        bool "Run WebSocket PCM echo test"
        default n
        help
            Connects to a PC WebSocket echo server, uploads binary PCM from
            microphone, and plays binary PCM received from the server.

    config AUDIO_BOARD_TEST_WS_URI
        string "WebSocket echo server URI"
        depends on AUDIO_BOARD_TEST_RUN_WS_ECHO
        default "ws://192.168.1.100:8765"

    config AUDIO_BOARD_TEST_WS_DURATION_MS
        int "WebSocket echo test duration (ms)"
        depends on AUDIO_BOARD_TEST_RUN_WS_ECHO
        default 10000
        range 1000 300000

    config AUDIO_BOARD_TEST_WS_TOKEN
        string "Optional WebSocket Authorization header"
        depends on AUDIO_BOARD_TEST_RUN_WS_ECHO
        default ""

    config XIAOZHI_AUDIO_DIAG_TONE_MS
        int "Audio diagnostics 1 kHz tone duration (ms)"
        default 500
        range 20 10000

    config XIAOZHI_AUDIO_DIAG_MIC_RMS_DURATION_MS
        int "Audio diagnostics mic RMS total duration (ms)"
        default 5000
        range 100 60000

    config XIAOZHI_AUDIO_DIAG_MIC_RMS_WINDOW_MS
        int "Audio diagnostics mic RMS log window (ms)"
        default 500
        range 20 10000

    config XIAOZHI_AUDIO_DIAG_LOOPBACK_MS
        int "Audio diagnostics local loopback duration (ms)"
        default 5000
        range 20 60000

    config XIAOZHI_AUDIO_DIAG_LOOPBACK_GAIN
        int "Audio diagnostics local loopback digital gain"
        default 4
        range 1 16

    config XIAOZHI_AUDIO_DIAG_LOOPBACK_LOG_MS
        int "Audio diagnostics local loopback log window (ms)"
        default 500
        range 20 10000

    config XIAOZHI_AUDIO_DIAG_VOLUME
        int "Audio diagnostics output volume"
        default 40
        range 0 100

    config XIAOZHI_AUDIO_DIAG_TONE_AMPLITUDE
        int "Audio diagnostics 1 kHz tone amplitude"
        default 12000
        range 1000 30000

    config XIAOZHI_AUDIO_OPUS_DIAG_TONE_LOOPBACK_MS
        int "Opus diagnostics 1 kHz loopback duration (ms)"
        default 5000
        range 60 60000

    config XIAOZHI_AUDIO_OPUS_DIAG_MIC_LOOPBACK_MS
        int "Opus diagnostics mic loopback duration (ms)"
        default 10000
        range 60 300000

    config XIAOZHI_AUDIO_OPUS_DIAG_MIC_INPUT_BYTES
        int "Opus diagnostics mic input chunk bytes"
        default 1024
        range 320 1920

    config XIAOZHI_AUDIO_OPUS_DIAG_LOG_WINDOW_MS
        int "Opus diagnostics log window (ms)"
        default 500
        range 60 10000

    config XIAOZHI_AUDIO_OPUS_DIAG_VOLUME
        int "Opus diagnostics output volume"
        default 65
        range 0 100

    config XIAOZHI_AUDIO_OPUS_DIAG_TONE_AMPLITUDE
        int "Opus diagnostics 1 kHz tone amplitude"
        default 10000
        range 1000 30000

    config XIAOZHI_AUDIO_OPUS_DIAG_BITRATE
        int "Opus diagnostics bitrate"
        default 32000
        range 20000 256000

    config XIAOZHI_AUDIO_OPUS_DIAG_COMPLEXITY
        int "Opus diagnostics encoder complexity"
        default 0
        range 0 10

endmenu

menu "Xiaozhi WiFi STA Configuration"

    config ESP_WIFI_SSID
        string "WiFi STA SSID"
        default ""

    config ESP_WIFI_PASSWORD
        string "WiFi STA Password"
        default ""

    choice ESP_WIFI_SAE_MODE
        prompt "WPA3 SAE mode selection"
        default ESP_WPA3_SAE_PWE_BOTH
        config ESP_WPA3_SAE_PWE_HUNT_AND_PECK
            bool "HUNT AND PECK"
        config ESP_WPA3_SAE_PWE_HASH_TO_ELEMENT
            bool "H2E"
        config ESP_WPA3_SAE_PWE_BOTH
            bool "BOTH"
    endchoice

    config ESP_WIFI_PW_ID
        string "PASSWORD IDENTIFIER"
        depends on ESP_WPA3_SAE_PWE_HASH_TO_ELEMENT || ESP_WPA3_SAE_PWE_BOTH
        default ""

    config ESP_MAXIMUM_RETRY
        int "Maximum retry"
        default 5
        range 1 20

    choice ESP_WIFI_SCAN_AUTH_MODE_THRESHOLD
        prompt "WiFi Scan auth mode threshold"
        default ESP_WIFI_AUTH_WPA2_PSK
        config ESP_WIFI_AUTH_OPEN
            bool "OPEN"
        config ESP_WIFI_AUTH_WEP
            bool "WEP"
        config ESP_WIFI_AUTH_WPA_PSK
            bool "WPA PSK"
        config ESP_WIFI_AUTH_WPA2_PSK
            bool "WPA2 PSK"
        config ESP_WIFI_AUTH_WPA_WPA2_PSK
            bool "WPA/WPA2 PSK"
        config ESP_WIFI_AUTH_WPA3_PSK
            bool "WPA3 PSK"
        config ESP_WIFI_AUTH_WPA2_WPA3_PSK
            bool "WPA2/WPA3 PSK"
        config ESP_WIFI_AUTH_WAPI_PSK
            bool "WAPI PSK"
    endchoice

endmenu
```

## test_apps/audio_board_test/sdkconfig.defaults
```kconfig
CONFIG_IDF_TARGET="esp32s3"
CONFIG_AUDIO_BOARD_TEST_RUN_I2C_SCAN=n
CONFIG_AUDIO_BOARD_TEST_RUN_1KHZ_TONE=n
CONFIG_AUDIO_BOARD_TEST_RUN_MIC_RMS=n
CONFIG_AUDIO_BOARD_TEST_RUN_LOCAL_LOOPBACK=n
CONFIG_AUDIO_BOARD_TEST_RUN_OPUS_1KHZ_LOOPBACK=y
CONFIG_AUDIO_BOARD_TEST_RUN_OPUS_MIC_LOOPBACK=n
CONFIG_AUDIO_BOARD_TEST_TASK_STACK_SIZE=49152
# CONFIG_AUDIO_BOARD_TEST_RUN_WS_ECHO is not set
CONFIG_ESPTOOLPY_FLASHSIZE_8MB=y
CONFIG_AUDIO_ENCODER_OPUS_SUPPORT=y
CONFIG_AUDIO_DECODER_OPUS_SUPPORT=y
CONFIG_SPIRAM=y
CONFIG_SPIRAM_MODE_QUAD=y
CONFIG_SPIRAM_TYPE_AUTO=y
CONFIG_SPIRAM_ALLOW_STACK_EXTERNAL_MEMORY=y
CONFIG_SPIRAM_SPEED_80M=y
CONFIG_SPIRAM_BOOT_INIT=y
CONFIG_SPIRAM_USE_CAPS_ALLOC=y
CONFIG_SPIRAM_MEMTEST=y
CONFIG_XIAOZHI_AUDIO_DIAG_TONE_MS=500
CONFIG_XIAOZHI_AUDIO_DIAG_MIC_RMS_DURATION_MS=5000
CONFIG_XIAOZHI_AUDIO_DIAG_MIC_RMS_WINDOW_MS=500
CONFIG_XIAOZHI_AUDIO_DIAG_LOOPBACK_MS=15000
CONFIG_XIAOZHI_AUDIO_DIAG_LOOPBACK_GAIN=4
CONFIG_XIAOZHI_AUDIO_DIAG_LOOPBACK_LOG_MS=500
CONFIG_XIAOZHI_AUDIO_DIAG_VOLUME=65
CONFIG_XIAOZHI_AUDIO_DIAG_TONE_AMPLITUDE=12000
CONFIG_XIAOZHI_AUDIO_OPUS_DIAG_FRAME_DURATION_60_MS=y
CONFIG_XIAOZHI_AUDIO_OPUS_DIAG_TONE_LOOPBACK_MS=5000
CONFIG_XIAOZHI_AUDIO_OPUS_DIAG_MIC_LOOPBACK_MS=10000
CONFIG_XIAOZHI_AUDIO_OPUS_DIAG_MIC_INPUT_BYTES=1024
CONFIG_XIAOZHI_AUDIO_OPUS_DIAG_LOG_WINDOW_MS=500
CONFIG_XIAOZHI_AUDIO_OPUS_DIAG_VOLUME=65
CONFIG_XIAOZHI_AUDIO_OPUS_DIAG_TONE_AMPLITUDE=10000
CONFIG_XIAOZHI_AUDIO_OPUS_DIAG_BITRATE=90000
CONFIG_XIAOZHI_AUDIO_OPUS_DIAG_COMPLEXITY=0
CONFIG_XIAOZHI_AUDIO_OPUS_DIAG_SOURCE_TASK_STACK_SIZE=6144
CONFIG_XIAOZHI_AUDIO_OPUS_DIAG_ENCODER_TASK_STACK_SIZE=49152
CONFIG_XIAOZHI_AUDIO_OPUS_DIAG_BRIDGE_TASK_STACK_SIZE=4096
CONFIG_XIAOZHI_AUDIO_OPUS_DIAG_DECODER_TASK_STACK_SIZE=24576
CONFIG_XIAOZHI_AUDIO_OPUS_DIAG_PCM_RING_BYTES=32768
CONFIG_XIAOZHI_AUDIO_OPUS_DIAG_OPUS_RING_BYTES=32768
```
